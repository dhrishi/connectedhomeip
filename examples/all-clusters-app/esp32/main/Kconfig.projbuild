## examples/all-clusters-app/esp32/main/Kconfig.projbuild
```kconfig
#
#    Copyright (c) 2020 Project CHIP Authors
#    All rights reserved.
#
#    Licensed under the Apache License, Version 2.0 (the "License");
#    you may not use this file except in compliance with the License.
#    You may obtain a copy of the License at
#
#        http://www.apache.org/licenses/LICENSE-2.0
#
#    Unless required by applicable law or agreed to in writing, software
#    distributed under the License is distributed on an "AS IS" BASIS,
#    WITHOUT WARRANTIES OR CONDITIONS OF ANY KIND, either express or implied.
#    See the License for the specific language governing permissions and
#    limitations under the License.
#
#    Description:
#      Configuration options CHIP ESP32 demo application.
#

menu "Demo"

menu "light driver config"
config LIGHT_GPIO_RED
    int "Light red pin GPIO number"
    range 0 33
    default 4
    help
        There are more enumerations like that
        up to GPIO39, excluding GPIO20, GPIO24 and GPIO28..31.
        They are not shown here to reduce redundant information.
        @note GPIO34..39 are input mode only.

config LIGHT_GPIO_GREEN
    int "Light green pin GPIO number"
    range 0 33
    default 16
    help
        There are more enumerations like that
        up to GPIO39, excluding GPIO20, GPIO24 and GPIO28..31.
        They are not shown here to reduce redundant information.
        @note GPIO34..39 are input mode only.

config LIGHT_GPIO_BLUE
    int "Light blue pin GPIO number"
    range 0 33
    default 5
    help
        There are more enumerations like that
        up to GPIO39, excluding GPIO20, GPIO24 and GPIO28..31.
        They are not shown here to reduce redundant information.
        @note GPIO34..39 are input mode only.

config LIGHT_GPIO_COLD
    int "Light cold colors pin GPIO number"
    range 0 33
    default 23
    help
        There are more enumerations like that
        up to GPIO39, excluding GPIO20, GPIO24 and GPIO28..31.
        They are not shown here to reduce redundant information.
        @note GPIO34..39 are input mode only.

config LIGHT_GPIO_WARM
    int "Light warm color pin GPIO number"
    range 0 33
    default 19
    help
        There are more enumerations like that
        up to GPIO39, excluding GPIO20, GPIO24 and GPIO28..31.
        They are not shown here to reduce redundant information.
        @note GPIO34..39 are input mode only.

config LIGHT_FADE_PERIOD_MS
    int "The time from the current color to the next color"
    default 500
    help
        The time from the current color to the next color.

config LIGHT_BLINK_PERIOD_MS
    int "Period of blinking lights"
    default 2000
    help
        Period of blinking lights.
endmenu

config LIGHT_VERSION
    string "Light version"
    default "1.3.1"
    help
        Version of the five-color light

config LIGHT_RESTART_COUNT_RESET
    int "Reset the number of times the device has been powered off continuously to enter the configured network mode"
    range 3 10
    default 3
    help
        Reset the number of times the device has been powered off continuously to enter the configured network mode.

    choice
        prompt "Device Type"
        default DEVICE_TYPE_ESP32_DEVKITC
        help
            Specifies the type of ESP32 device.

            Note that the "ESP32-DevKitC" choice is compatible with a number of clone devices
            available from third-party manufacturers.

        config DEVICE_TYPE_ESP32_DEVKITC
            bool "ESP32-DevKitC"
        config DEVICE_TYPE_ESP32_WROVER_KIT
            bool "ESP32-WROVER-KIT_V4.1"
        config DEVICE_TYPE_M5STACK
            bool "M5Stack"
    endchoice

    choice
      prompt "Rendezvous Mode"
      default RENDEZVOUS_MODE_WIFI
      help
          Specifies the Rendezvous mode of the peripheral.

      config RENDEZVOUS_MODE_BYPASS
          bool "Bypass"
      config RENDEZVOUS_MODE_WIFI
          bool "Wi-Fi"
      config RENDEZVOUS_MODE_BLE
          bool "BLE"
      config RENDEZVOUS_MODE_THREAD
          bool "Thread"
      config RENDEZVOUS_MODE_ETHERNET
          bool "Ethernet"
    endchoice

    config ECHO_HOST_IP
        string "IPV4 address"
        default "127.0.0.1"
        depends on USE_ECHO_CLIENT
        help
            The IPV4 Address of the ECHO Server.

    # NOTE: This config is not displayed as a input in the Kconfig menu, as its value is
    # entirely derived from the Device Type choice.  However the CONFIG_EXAMPLE_DISPLAY_TYPE
    # define that is produced is needed to configure the TFT library correctly.
    config TFT_PREDEFINED_DISPLAY_TYPE
        int
        range 0 5
        default 0 if DEVICE_TYPE_ESP32_DEVKITC
        default 3 if DEVICE_TYPE_M5STACK
        default 4 if DEVICE_TYPE_ESP32_WROVER_KIT

    config RENDEZVOUS_MODE
       int
       range 0 8
       default 0 if RENDEZVOUS_MODE_BYPASS
       default 1 if RENDEZVOUS_MODE_WIFI
       default 2 if RENDEZVOUS_MODE_BLE
       default 4 if RENDEZVOUS_MODE_THREAD
       default 8 if RENDEZVOUS_MODE_ETHERNET

    config DISPLAY_AUTO_OFF
        bool "Automatically turn off the M5Stack's Display after a few seconds"
        default "y"
        depends on DEVICE_TYPE_M5STACK
        help
            To reduce wear and heat the M5Stack's Display is automatically switched off after a few seconds


endmenu
```
